## board/d13x/demo88-nor/Kconfig
```kconfig
#
# Contest 2026 demo88-nor board placeholder
#

if ARCH_BOARD_CUSTOM

config CONTEST2026_094_ANDY_BOARD_DEMO88_NOR
    bool "contest2026_094_andy demo88-nor"
    default y
    help
      Placeholder board entry for the custom D13X board tree.

endif
```

## chip/d13x/Kconfig
```kconfig
#
# Contest 2026 custom D13X chip stub
#

if ARCH_CHIP_CUSTOM

comment "Contest 2026 D13X Chip Options"

choice
    prompt "Custom RISC-V chip selection"
    default ARCH_CHIP_ARTINCHIP_D13X

config ARCH_CHIP_ARTINCHIP_D13X
    bool "ArtInChip D13X (contest stub)"
    select ARCH_RV32
    select ARCH_RV_ISA_M
    select ARCH_RV_ISA_A
    select ARCH_RV_ISA_C
    select ARCH_HAVE_FPU
    select ARCH_FPU
    select ARCH_HAVE_RESET
    help
      Minimal custom chip entry for the contest D13X port. This only
      provides build glue and placeholder low-level code.

endchoice

endif
```
